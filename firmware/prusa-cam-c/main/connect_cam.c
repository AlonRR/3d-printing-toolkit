/* Snapshot upload to Prusa Connect.
 *
 * THE CONTRACT, read from Prusa's published camera OpenAPI rather than assumed:
 *
 *     PUT https://connect.prusa3d.com/c/snapshot
 *       Token:        <issued by Connect for this camera>
 *       Fingerprint:  <generated by the camera, 16-64 characters>
 *       Content-Type: image/jpg
 *       body: the raw JPEG, 16 MB maximum
 *     -> 204 No Content on success
 *
 * Note it is PUT, not POST. And 204 specifically is success - treating "any
 * 2xx" as success would swallow a redirect or an unexpected 200 body that means
 * something else entirely.
 *
 * This is the ONLY officially supported Connect API. The mobile gateway can
 * read the queue and start prints, but it is the phone app's own backend at
 * version 0.0.1-dev with app-minted JWTs; see docs/prusa-connect-api.md.
 */

#include "connect_cam.h"

#include <stdio.h>
#include <string.h>

#include "esp_crt_bundle.h"
#include "esp_http_client.h"
#include "esp_log.h"
#include "esp_mac.h"
#include "wifi_secrets.h"

static const char *TAG = "connect";

#define SNAPSHOT_URL "https://connect.prusa3d.com/c/snapshot"

/* 8 + 12 = 20 characters, inside the 16-64 the API requires. */
static char s_fingerprint[24] = "";

void connect_cam_init(void)
{
    uint8_t mac[6];
    esp_read_mac(mac, ESP_MAC_WIFI_STA);
    snprintf(s_fingerprint, sizeof(s_fingerprint),
             "esp32s3-%02x%02x%02x%02x%02x%02x",
             mac[0], mac[1], mac[2], mac[3], mac[4], mac[5]);
    ESP_LOGI(TAG, "fingerprint %s (%u chars)",
             s_fingerprint, (unsigned) strlen(s_fingerprint));
}

const char *connect_cam_fingerprint(void)
{
    return s_fingerprint;
}

esp_err_t connect_cam_upload(const uint8_t *jpeg, size_t len)
{
    if (s_fingerprint[0] == '\0') {
        ESP_LOGE(TAG, "connect_cam_init has not been called");
        return ESP_ERR_INVALID_STATE;
    }
    if (jpeg == NULL || len < 4) {
        return ESP_ERR_INVALID_ARG;
    }
    /* The token is a placeholder until one is issued by Connect. Checked here
     * so the failure says exactly that, rather than surfacing as a puzzling
     * 401 from the server. */
    /* Compared against the placeholder itself, not merely a length. The first
     * version tested strlen < 8, and "PASTE_TOKEN_HERE" is sixteen characters -
     * so it sailed through and uploaded a placeholder to Prusa's servers on a
     * timer. A guard has to test for the thing it is guarding against. */
    if (strcmp(PRUSA_CAMERA_TOKEN, "PASTE_TOKEN_HERE") == 0
        || strlen(PRUSA_CAMERA_TOKEN) < 8) {
        ESP_LOGW(TAG, "no camera token set - upload skipped. Put it in "
                      "main/wifi_secrets.h as PRUSA_CAMERA_TOKEN");
        return ESP_ERR_INVALID_STATE;
    }

    esp_http_client_config_t cfg = {
        .url = SNAPSHOT_URL,
        .method = HTTP_METHOD_PUT,
        /* Espressif's bundled root CAs. Connect is a public HTTPS endpoint, so
         * no certificate needs shipping with the firmware - and verification
         * stays ON, which matters when a token travels in the headers. */
        .crt_bundle_attach = esp_crt_bundle_attach,
        .timeout_ms = 15000,
    };

    esp_http_client_handle_t c = esp_http_client_init(&cfg);
    if (!c) {
        ESP_LOGE(TAG, "http client init failed");
        return ESP_FAIL;
    }

    esp_http_client_set_header(c, "Token", PRUSA_CAMERA_TOKEN);
    esp_http_client_set_header(c, "Fingerprint", s_fingerprint);
    esp_http_client_set_header(c, "Content-Type", "image/jpg");

    esp_err_t err = esp_http_client_open(c, len);
    if (err != ESP_OK) {
        ESP_LOGE(TAG, "connect failed: %s", esp_err_to_name(err));
        esp_http_client_cleanup(c);
        return err;
    }

    /* Written in chunks rather than one call: esp_http_client_write returns
     * after a partial write, exactly like send(), so a single call is not a
     * sent body. */
    size_t sent = 0;
    while (sent < len) {
        int n = esp_http_client_write(c, (const char *) jpeg + sent, len - sent);
        if (n <= 0) {
            ESP_LOGE(TAG, "write failed after %u of %u bytes",
                     (unsigned) sent, (unsigned) len);
            esp_http_client_close(c);
            esp_http_client_cleanup(c);
            return ESP_FAIL;
        }
        sent += (size_t) n;
    }

    int status = 0;
    if (esp_http_client_fetch_headers(c) >= 0) {
        status = esp_http_client_get_status_code(c);
    }
    esp_http_client_close(c);
    esp_http_client_cleanup(c);

    /* The published OpenAPI documents 204 as the success response. The LIVE
     * server returns 200, verified by the snapshot appearing in Connect. Both
     * are accepted, with the spec's own value listed first - being strict about
     * 204 alone reported a working upload as a failure. A spec is evidence
     * about intent; the server is evidence about behaviour. */
    if (status == 204 || status == 200) {
        ESP_LOGI(TAG, "uploaded %u bytes -> %d", (unsigned) len, status);
        return ESP_OK;
    }

    /* Each of these means something different and needs a different fix, so
     * they are not collapsed into one "upload failed". */
    switch (status) {
    case 401:
        ESP_LOGE(TAG, "401 - the Token is wrong or not for this camera");
        break;
    case 403:
        ESP_LOGE(TAG, "403 - token valid but not permitted for this camera");
        break;
    case 404:
        ESP_LOGE(TAG, "404 - no camera registered for this Fingerprint. "
                      "Register %s in Connect", s_fingerprint);
        break;
    case 400:
        ESP_LOGE(TAG, "400 - Connect rejected the image itself");
        break;
    case 422:
        /* Undocumented in the OpenAPI, but what Connect actually returns for a
         * malformed Token - observed with the placeholder in place. */
        ESP_LOGE(TAG, "422 - Connect processed the request but rejected the "
                      "Token as malformed. The upload path itself is working; "
                      "only the credential is wrong");
        break;
    default:
        ESP_LOGE(TAG, "unexpected status %d", status);
        break;
    }
    return ESP_FAIL;
}
